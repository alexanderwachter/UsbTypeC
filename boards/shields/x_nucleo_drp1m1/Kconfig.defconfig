## boards/shields/x_nucleo_drp1m1/Kconfig.shield
```kconfig
# Copyright (c) 2026 Alexander Wachter
# SPDX-License-Identifier: Apache-2.0

config SHIELD_X_NUCLEO_DRP1M1
	def_bool $(shields_list_contains,x_nucleo_drp1m1)
```

## boards/shields/x_nucleo_usbpdm1/Kconfig.shield
```kconfig
# Copyright (c) 2026 Alexander Wachter
# SPDX-License-Identifier: Apache-2.0

config SHIELD_X_NUCLEO_USBPDM1
	def_bool $(shields_list_contains,x_nucleo_usbpdm1)
```

## zephyr/Kconfig
```kconfig
# Copyright (c) 2026 Alexander Wachter
#
# SPDX-License-Identifier: Apache-2.0

config USB_TYPEC_STACK
	bool "USB Type-C stack with Power Delivery"
	select CPP
	select REQUIRES_FULL_LIBCPP
	help
	  Enable the UsbTypeC library: USB Type-C connection state machines
	  and USB Power Delivery according to the USB Type-C Cable and
	  Connector Specification and the USB PD Specification.

if USB_TYPEC_STACK

config USB_TYPEC_STACK_THREAD_PRIORITY
	int "USB Type-C stack thread priority"
	default 0
	help
	  Priority of the stack's work queue thread. All stack processing -
	  TCPC alerts, VBUS monitoring, and the protocol timers - runs on
	  this thread.

config USB_TYPEC_STACK_STACK_SIZE
	int "USB Type-C stack thread stack size"
	default 1024
	help
	  Stack size of the stack's work queue thread.

module = USB_TYPEC_STACK
module-str = USB Type-C stack
source "subsys/logging/Kconfig.template.log_config"

endif # USB_TYPEC_STACK
```

## zephyr/drivers/Kconfig
```kconfig
# Copyright (c) 2026 Alexander Wachter
# SPDX-License-Identifier: Apache-2.0

rsource "usb_c/ppc/Kconfig"
```

## zephyr/drivers/usb_c/ppc/Kconfig
```kconfig
# Copyright (c) 2026 Alexander Wachter
# SPDX-License-Identifier: Apache-2.0

config USBC_PPC_TCPP03_M20
	bool "STMicroelectronics TCPP03-M20 port protection"
	default y
	depends on DT_HAS_ST_TCPP03_M20_ENABLED
	depends on USBC_PPC_DRIVER
	select I2C
	select GPIO
	help
	  Power path controller driver for the ST TCPP03-M20
```

## zephyr/dts/bindings/ppc/st,tcpp03-m20.yaml
```yaml
# Copyright (c) 2026 Alexander Wachter
# SPDX-License-Identifier: Apache-2.0

description: |
  STMicroelectronics TCPP03-M20 USB Type-C port protection for dual
  role power, controlled over I2C: gate drivers for the external
  N-MOSFETs of the sink (consumer) and source (provider) VBUS paths,
  VBUS and VCONN discharge, a VCONN switch onto either CC pin, CC and
  VBUS overvoltage protection, VBUS overcurrent protection, and fault
  flags on the open-drain FLGn pin.

  The I2C address is 0x34 with I2C_ADD low, 0x35 with it high.

compatible: "st,tcpp03-m20"

include: i2c-device.yaml

properties:
  enable-gpios:
    type: phandle-array
    description: |
      The ENABLE pin. Low holds the device in reset: its dead-battery Rd
      sits on the CC pins and the I2C registers are cleared. The driver
      drives it high at init. Leave the property out on a board that
      ties the pin high.

  irq-gpios:
    type: phandle-array
    description: |
      The FLGn pin, open drain, active low. In the normal power mode it
      signals a fault (overvoltage, overcurrent, overtemperature); the
      driver reads the flag register then and reports through the PPC
      event handler. Leave the property out when the pin does not reach
      the MCU.
```
